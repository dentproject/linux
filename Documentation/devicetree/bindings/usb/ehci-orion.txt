## Documentation/devicetree/bindings/usb/ehci-orion.txt
```
* EHCI controller, Orion Marvell variants

Required properties:
- compatible: must be one of the following
	"marvell,orion-ehci"
	"marvell,armada-3700-ehci"
	"marvell,ac5-ehci"
- reg: physical base address of the controller and length of memory mapped
  region.
- interrupts: The EHCI interrupt

Optional properties:
- clocks: reference to the clock
- phys: reference to the USB PHY
- phy-names: name of the USB PHY, should be "usb"
- max-speed-full-speed: Limit USB to full speed

Example:

	ehci@50000 {
		compatible = "marvell,orion-ehci";
		reg = <0x50000 0x1000>;
		interrupts = <19>;
	};
```
